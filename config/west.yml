## config/west.yml
```yaml
manifest:
  remotes:
    - name: zmk
      url-base: https://github.com/zmkfirmware
    - name: user
      url-base: https://github.com/jshd784ogm717zpcvdj8wek-bit

  projects:
    - name: zmk
      remote: zmk
      revision: main
      import: app/west.yml

    - name: zmk-pmw3610-driver
      remote: user
      revision: main          # （安定させたいなら、ここを自分のフォークのコミットSHAに）
      path: zmk-pmw3610-driver

  self:
    path: .
```
